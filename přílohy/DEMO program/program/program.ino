//knihovny pro OLED
#include <SPI.h>
#include <Wire.h>
#include <Adafruit_SSD1306.h>

//knihovny pro WIFI
#include <WiFi.h>

//knihovny pro MQTT
#include <PubSubClient.h>

//knihovny pro OTA
#include <ArduinoOTA.h>
#include <ESPmDNS.h>
#include <WiFiUdp.h>

//knihovny pro 433MHz komunikaci
#include <RCSwitch.h>
RCSwitch mySwitch = RCSwitch();



//definice displeje
#define SCREEN_WIDTH 128
#define SCREEN_HEIGHT 64
#define OLED_RESET 4
#define SCREEN_ADDRESS 0x3c
#define LOGO_WIDTH 128
#define LOGO_HEIGHT 64
Adafruit_SSD1306 display(SCREEN_WIDTH, SCREEN_HEIGHT, &Wire, OLED_RESET);


//definice pinů
//MBus
#define MRX 42
#define MTX 41

//RS485
#define DI 40
#define DE 39
#define RE 38
#define RO 37

//433MHz RX, TX
#define rf_RX 34
#define rf_TX 33

//mosfet výstupy
#define Q1 17
#define Q2 18
#define Q3 19

//relé výystupy
#define L1 13
#define L2 14
#define L3 15
#define L4 16

//analagově/digitální vstupy
#define I1 12
#define I2 11
#define I3 10
#define I4 7
#define I5 6

//proudová smyčka
#define AI1 2
#define AI2 1

const char* ssid = "******";
const char* password = "******";

const char* mqtt_server = "******";  // IP mqtt serveru
const char* mqtt_username = "******"; // MQTT jmeno
const char* mqtt_password = "******"; // MQTT heslo
const char* clientID = "******"; // MQTT ID přezdívka


//pomocné promněnné
int counter = 0;
String str;
int stary = 0;
int stary2 = 0;


WiFiClient wificlient;
PubSubClient client(mqtt_server, 1883, wificlient);

const unsigned char logo [] PROGMEM = {
  0x00, 0x00, 0x00, 0x00, 0x00, 0x00, 0xf0, 0x00, 0x00, 0x00, 0x00, 0x00, 0x07, 0xff, 0xff, 0xff,
  0x00, 0x00, 0x00, 0x00, 0x00, 0x00, 0xf0, 0x00, 0x00, 0x00, 0x00, 0x00, 0x07, 0xff, 0xff, 0xff,
  0x00, 0x00, 0x00, 0x00, 0x00, 0x00, 0xf0, 0x00, 0x00, 0x00, 0x00, 0x00, 0x07, 0xff, 0xff, 0xff,
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  0x00, 0x00, 0x00, 0x00, 0x00, 0x00, 0x00, 0x00, 0x00, 0x00, 0x00, 0x00, 0x07, 0xff, 0xff, 0xff
};


void setup() {
  //nastanevení pinů na INPUT/OUTPUT
  //Mbus
  pinMode(MRX, INPUT);
  pinMode(MTX, OUTPUT);

  //RS485
  pinMode(DI, OUTPUT);
  pinMode(DE, OUTPUT);
  pinMode(RE, OUTPUT);
  pinMode(RO, INPUT);

  //433 MHz RX, TX
  pinMode(rf_RX, INPUT);
  pinMode(rf_TX, OUTPUT);

  //mosfet výstupy
  pinMode(Q1, OUTPUT);
  pinMode(Q2, OUTPUT);
  pinMode(Q3, OUTPUT);

  //relé výstupy
  pinMode(L1, OUTPUT);
  pinMode(L2, OUTPUT);
  pinMode(L3, OUTPUT);
  pinMode(L4, OUTPUT);

  //analagově/digitální vstupy
  pinMode(I1, INPUT);
  pinMode(I2, INPUT);
  pinMode(I3, INPUT);
  pinMode(I4, INPUT);
  pinMode(I5, INPUT);

  //proudová smmyčka
  pinMode(AI1, INPUT);
  pinMode(AI2, INPUT);


  mySwitch.enableTransmit(digitalPinToInterrupt(rf_TX));
  mySwitch.enableReceive(digitalPinToInterrupt(rf_RX));
  mySwitch.setRepeatTransmit(10);
  mySwitch.setPulseLength(500);


  //inicializace displeje
  display.begin(SSD1306_SWITCHCAPVCC, SCREEN_ADDRESS);
  //zobrazení loga
  startup_logo();

  Serial.begin(115200);
  Serial.println("Booting");

  WiFi.mode(WIFI_STA);
  WiFi.begin(ssid, password);
  while (WiFi.waitForConnectResult() != WL_CONNECTED) {
    Serial.println("Connection Failed! Rebooting...");
    delay(5000);
    ESP.restart();
  }


  mqtt_reconnect();

  ArduinoOTA.setHostname("******");
  ArduinoOTA.setPassword("******");
  ArduinoOTA
  .onStart([]() {
    String type;
    if (ArduinoOTA.getCommand() == U_FLASH)
      type = "sketch";
    else // U_SPIFFS
      type = "filesystem";

    // NOTE: if updating SPIFFS this would be the place to unmount SPIFFS using SPIFFS.end()
    Serial.println("Start updating " + type);
  })
  .onEnd([]() {
    Serial.println("\nEnd");
  })
  .onProgress([](unsigned int progress, unsigned int total) {
    Serial.printf("Progress: %u%%\r", (progress / (total / 100)));
  })
  .onError([](ota_error_t error) {
    Serial.printf("Error[%u]: ", error);
    if (error == OTA_AUTH_ERROR) Serial.println("Auth Failed");
    else if (error == OTA_BEGIN_ERROR) Serial.println("Begin Failed");
    else if (error == OTA_CONNECT_ERROR) Serial.println("Connect Failed");
    else if (error == OTA_RECEIVE_ERROR) Serial.println("Receive Failed");
    else if (error == OTA_END_ERROR) Serial.println("End Failed");
  });

  ArduinoOTA.begin();

  Serial.println("Ready");
  Serial.print("IP address: ");
  Serial.println(WiFi.localIP());

}


void loop() {
  while (WiFi.status() != WL_CONNECTED) {
    delay(500);
    Serial.print(".");
    counter++;
    if (counter == 1) {
      wifi_error();
    }
    if (counter >= 60) {
      ESP.restart();
    }
  }

  show_ip();

  ArduinoOTA.handle();
  mqtt_reconnect();
  client.loop();

  if (mySwitch.available()) {
    if (mySwitch.getReceivedValue() == 14257176) {
      client.publish("home/inputs/zvonek", "on");
    }
    mySwitch.resetAvailable();
  }
  else {
    if (millis() - stary2 > 5000) {
      client.publish("home/inputs/zvonek", "off");
      stary2 = millis();
    }
  }



  if (millis() - stary > 5000) {
    stary = millis();
    if (digitalRead(I1)) {
      client.publish("home/inputs/I1", "on");
    }
    else {
      client.publish("home/inputs/I1", "off");
    }
    if (digitalRead(I2)) {
      client.publish("home/inputs/I2", "on");
    }
    else {
      client.publish("home/inputs/I2", "off");
    }
    str = String(analogRead(I3));
    client.publish("home/inputs/I3", str.c_str());
    str = String(analogRead(I4));
    client.publish("home/inputs/I4", str.c_str());
    str = String(analogRead(I5));
    client.publish("home/inputs/I5", str.c_str());

    str = String(analogRead(AI1));
    client.publish("home/inputs/AI1", str.c_str());
    str = String(analogRead(AI2));
    client.publish("home/inputs/AI2", str.c_str());

  }


  /*
    if (digitalRead(I1)) {
      digitalWrite(L1, HIGH);
    }
    else {
      digitalWrite(L1, LOW);
    }

  */

  /*
    digitalWrite(L1, HIGH);
    delay(500);
    digitalWrite(L1, LOW);
    delay(500);
    digitalWrite(Q1, HIGH);
    delay(500);
    digitalWrite(Q1, LOW);
    delay(500);
  */



}


void mqtt_error(void) {
  display.clearDisplay();
  display.setTextSize(2);
  display.setTextColor(WHITE);
  display.setCursor(0, 0);
  display.println("MQTT ERROR");
  Serial.println("MQTT ERROR");
  display.display();
}

void wifi_error(void) {
  display.clearDisplay();
  display.setTextSize(2);
  display.setTextColor(WHITE);
  display.setCursor(0, 0);
  display.println("WIFI ERROR");
  Serial.println("WIFI ERROR");
  display.display();
}

void startup_logo(void) {
  display.clearDisplay();
  display.drawBitmap(0, 0, logo, LOGO_WIDTH, LOGO_HEIGHT, 1);
  display.fillRect(100, 0, 30, 64, 0);
  display.display();
  delay(2000);
  display.clearDisplay();
  display.display();
}

void show_ip(void) {
  display.setTextSize(1);
  display.setTextColor(WHITE);
  display.setCursor(0, 0);
  display.println(WiFi.localIP());
  display.display();
}

void mqtt_reconnect() {
  while (!client.connected()) {
    if (client.connect(clientID, mqtt_username, mqtt_password)) {
      client.subscribe("home/outputs/L1");
      client.subscribe("home/outputs/L2");
      client.subscribe("home/outputs/L3");
      client.subscribe("home/outputs/L4");

      client.subscribe("home/outputs/Q1");
      client.subscribe("home/outputs/Q2");
      client.subscribe("home/outputs/Q3");

      client.subscribe("home/outputs/zasuvka1");
      client.subscribe("home/outputs/zasuvka2");
      client.subscribe("home/outputs/zvonek");



      client.setCallback(callback);
    } else {
      mqtt_error();
      delay(1000);
    }
  }
}
void send_mqtt(void) {
  client.publish("home/inputs", String(analogRead(I1)).c_str());
}

void callback(char* topic, byte* message, unsigned int length) {
  String mess;
  for (int i = 0; i < length; i++) {
    mess += (char)message[i];
  }

  if (String(topic) == "home/outputs/L1") {
    if (mess == "on") {
      digitalWrite(L1, HIGH);
    }
    else if (mess == "off") {
      digitalWrite(L1, LOW);
    }
  }

  if (String(topic) == "home/outputs/L2") {
    if (mess == "on") {
      digitalWrite(L2, HIGH);
    }
    else if (mess == "off") {
      digitalWrite(L2, LOW);
    }
  }

  if (String(topic) == "home/outputs/L3") {
    if (mess == "on") {
      digitalWrite(L3, HIGH);
    }
    else if (mess == "off") {
      digitalWrite(L3, LOW);
    }
  }

  if (String(topic) == "home/outputs/L4") {
    if (mess == "on") {
      digitalWrite(L4, HIGH);
    }
    else if (mess == "off") {
      digitalWrite(L4, LOW);
    }
  }

  if (String(topic) == "home/outputs/Q1") {
    if (mess == "on") {
      digitalWrite(Q1, HIGH);
    }
    else if (mess == "off") {
      digitalWrite(Q1, LOW);
    }
  }

  if (String(topic) == "home/outputs/Q2") {
    if (mess == "on") {
      digitalWrite(Q2, HIGH);
    }
    else if (mess == "off") {
      digitalWrite(Q2, LOW);
    }
  }

  if (String(topic) == "home/outputs/Q3") {
    if (mess == "on") {
      digitalWrite(Q3, HIGH);
    }
    else if (mess == "off") {
      digitalWrite(Q3, LOW);
    }
  }

  if (String(topic) == "home/outputs/zasuvka1") {
    if (mess == "on") {
      //mySwitch.send(14257176, 24);
    }
  }

  if (String(topic) == "home/outputs/zasuvka2") {
    if (mess == "on") {
      //mySwitch.send(4203775893, 32);
    }
  }
  if (String(topic) == "home/outputs/zvonek") {
    if (mess == "on") {
      mySwitch.send(14257176, 24);
    }
  }
}
